SUBSYS_SYSTEST_DIR  := $(TOP)/PLAT/subsys/systest
CFLAGS_INC += -I $(SUBSYS_SYSTEST_DIR)/inc

CFLAGS += -DFEATURE_SUBSYS_SYSTEST_ENABLE

SUBSYS_SYSTEST_PLAY_TTS_ENABLE            = y
SUBSYS_SYSTEST_PLAY_MP3_ENABLE            = y
SUBSYS_SYSTEST_PLAY_WAV_ENABLE            = y
SUBSYS_SYSTEST_PLAY_PCM_ENABLE            = y
SUBSYS_SYSTEST_CHANGE_VOLUME_ENABLE       = y
SUBSYS_SYSTEST_TRAVERSAL_PLAY_MP3_ENABLE  = n
SUBSYS_SYSTEST_TRAVERSAL_PLAY_WAV_ENABLE  = n
SUBSYS_SYSTEST_PLAY_TTS_AFTER_BOOT_ENABLE = n
SUBSYS_SYSTEST_PLAY_MP3_AFTER_BOOT_ENABLE = n
SUBSYS_SYSTEST_PLAY_TTS_AND_REPORT_ENABLE = n
SUBSYS_SYSTEST_PLAY_MP3_AND_REPORT_ENABLE = n
SUBSYS_SYSTEST_PLAY_WAV_AND_REPORT_ENABLE = n
SUBSYS_SYSTEST_ACCESS_FILE_ENABLE         = y
SUBSYS_SYSTEST_MQTT_REPORT_ENABLE         = n
ifeq ($(SUBSYS_STORAGE_ENABLE)_$(SUBSYS_FLASHEX_ENABLE), y_y)
ifeq ($(SUBSYS_LFSEX_ENABLE), y)
SUBSYS_SYSTEST_FLASH_LFS_ENABLE           = y
endif
endif
ifeq ($(SUBSYS_FLASHEX_ENABLE), y)
SUBSYS_SYSTEST_FLASH_PERFORMANCE_ENABLE   = y
endif

ifeq ($(SUBSYS_CMDPARSE_ENABLE),y)
include $(SUBSYS_SYSTEST_DIR)/cmdparse/Makefile.inc
endif
ifeq ($(SUBSYS_SYSTEST_PLAY_TTS_ENABLE),y)
CFLAGS += -DFEATURE_SUBSYS_SYSTEST_PLAY_TTS_ENABLE
endif
ifeq ($(SUBSYS_SYSTEST_PLAY_MP3_ENABLE),y)
CFLAGS += -DFEATURE_SUBSYS_SYSTEST_PLAY_MP3_ENABLE
endif
ifeq ($(SUBSYS_SYSTEST_PLAY_WAV_ENABLE),y)
CFLAGS += -DFEATURE_SUBSYS_SYSTEST_PLAY_WAV_ENABLE
endif
ifeq ($(SUBSYS_SYSTEST_PLAY_PCM_ENABLE),y)
CFLAGS += -DFEATURE_SUBSYS_SYSTEST_PLAY_PCM_ENABLE
endif
ifeq ($(SUBSYS_SYSTEST_CHANGE_VOLUME_ENABLE),y)
CFLAGS += -DFEATURE_SUBSYS_SYSTEST_CHANGE_VOLUME_ENABLE
endif
ifeq ($(SUBSYS_SYSTEST_TRAVERSAL_PLAY_MP3_ENABLE),y)
CFLAGS += -DFEATURE_SUBSYS_SYSTEST_TRAVERSAL_PLAY_MP3_ENABLE
endif
ifeq ($(SUBSYS_SYSTEST_TRAVERSAL_PLAY_WAV_ENABLE),y)
CFLAGS += -DFEATURE_SUBSYS_SYSTEST_TRAVERSAL_PLAY_WAV_ENABLE
endif
ifeq ($(SUBSYS_SYSTEST_PLAY_TTS_AFTER_BOOT_ENABLE),y)
CFLAGS += -DFEATURE_SUBSYS_SYSTEST_PLAY_TTS_AFTER_BOOT_ENABLE
endif
ifeq ($(SUBSYS_SYSTEST_PLAY_MP3_AFTER_BOOT_ENABLE),y)
CFLAGS += -DFEATURE_SUBSYS_SYSTEST_PLAY_MP3_AFTER_BOOT_ENABLE
endif
ifeq ($(SUBSYS_SYSTEST_PLAY_TTS_AND_REPORT_ENABLE),y)
CFLAGS += -DFEATURE_SUBSYS_SYSTEST_PLAY_TTS_AND_REPORT_ENABLE
endif
ifeq ($(SUBSYS_SYSTEST_PLAY_MP3_AND_REPORT_ENABLE),y)
CFLAGS += -DFEATURE_SUBSYS_SYSTEST_PLAY_MP3_AND_REPORT_ENABLE
endif
ifeq ($(SUBSYS_SYSTEST_PLAY_WAV_AND_REPORT_ENABLE),y)
CFLAGS += -DFEATURE_SUBSYS_SYSTEST_PLAY_WAV_AND_REPORT_ENABLE
endif
ifeq ($(SUBSYS_SYSTEST_ACCESS_FILE_ENABLE),y)
CFLAGS += -DFEATURE_SUBSYS_SYSTEST_ACCESS_FILE_ENABLE
endif
ifeq ($(SUBSYS_SYSTEST_MQTT_REPORT_ENABLE),y)
CFLAGS += -DFEATURE_SUBSYS_SYSTEST_MQTT_REPORT_ENABLE
endif
ifeq ($(SUBSYS_SYSTEST_FLASH_LFS_ENABLE),y)
CFLAGS += -DFEATURE_SUBSYS_SYSTEST_FLASH_LFS_ENABLE
endif
ifeq ($(SUBSYS_SYSTEST_FLASH_PERFORMANCE_ENABLE),y)
CFLAGS += -DFEATURE_SUBSYS_SYSTEST_FLASH_PERFORMANCE_ENABLE
endif

SUBSYS_SYSTEST_SRC_DIRS += $(SUBSYS_SYSTEST_DIR)/src

SUBSYS_SYSTEST_EXCLUDE_FILES :=

SUBSYS_SYSTEST_CSRC = $(foreach dir, $(SUBSYS_SYSTEST_SRC_DIRS), $(wildcard $(dir)/*.c))
SUBSYS_SYSTEST_CFILES = $(filter-out $(SUBSYS_SYSTEST_EXCLUDE_FILES), $(SUBSYS_SYSTEST_CSRC))
SUBSYS_SYSTEST_COBJSTEMP := $(patsubst %.c, %.o, $(SUBSYS_SYSTEST_CFILES))
SUBSYS_SYSTEST_COBJSTEMP :=$(subst $(SUBSYS_SYSTEST_DIR),PLAT/subsys/systest,$(SUBSYS_SYSTEST_COBJSTEMP))
SUBSYS_SYSTEST_COBJS := $(addprefix $(BUILDDIR)/, $(SUBSYS_SYSTEST_COBJSTEMP))
SUBSYS_SYSTEST_PPFILES := $(patsubst %.o, %.pp, $(SUBSYS_SYSTEST_COBJS))
PPFILES += $(SUBSYS_SYSTEST_PPFILES)


ifneq ($(MAKECMDGOALS), build-unilog)
-include $(SUBSYS_SYSTEST_COBJS:.o=.d)
endif
-include $(SUBSYS_SYSTEST_COBJS:.o=.dd)

ifeq ($(TOOLCHAIN),GCC)

CFLAGS_INC += -I $(TOP)/PLAT/os/freertos/portable/gcc

lib-y += libsubsys_systest.a

$(BUILDDIR)/lib/libsubsys_systest.a: $(SUBSYS_SYSTEST_COBJS)
	@mkdir -p $(dir $@)
	$(ECHO) AR $@
	$(Q)$(AR) -cr $@ $^

endif

ifeq ($(TOOLCHAIN),ARMCC)

CFLAGS_INC += -I $(TOP)/PLAT/os/freertos/portable/keil

lib-y += libsubsys_systest.lib

$(BUILDDIR)/lib/libsubsys_systest.lib: $(SUBSYS_SYSTEST_COBJS)
	@mkdir -p $(dir $@)
	$(ECHO) AR $@
	$(Q)$(AR) $(ARFLAGS) $@ $^

endif
