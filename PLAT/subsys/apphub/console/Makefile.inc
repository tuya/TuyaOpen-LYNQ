SUBSYS_CONSOLE_DIR  := $(TOP)/PLAT/subsys/apphub/console

CFLAGS_INC += 	-I $(SUBSYS_CONSOLE_DIR)/inc 

SUBSYS_CONSOLE_SRC_DIRS += 	$(SUBSYS_CONSOLE_DIR)/src 

CFLAGS += -DFEATURE_SUBSYS_CONSOLE_ENABLE
CFLAGS += -DPIKA_DEBUG_ENABLE=1
CFLAGS += -DUSB_CONSOLE

SUBSYS_CONSOLE_EXCLUDE_FILES :=

SUBSYS_CONSOLE_CSRC = $(foreach dir, $(SUBSYS_CONSOLE_SRC_DIRS), $(wildcard $(dir)/*.c))
SUBSYS_CONSOLE_CFILES = $(filter-out $(SUBSYS_CONSOLE_EXCLUDE_FILES), $(SUBSYS_CONSOLE_CSRC))
ifeq ($(SUBSYS_SOCKET_DEMO_ENABLE),y)
SUBSYS_CONSOLE_CFILES += $(SUBSYS_CONSOLE_DIR)/ext/console_socket.c 
endif
ifeq ($(SUBSYS_HTTP_DEMO_ENABLE),y)
SUBSYS_CONSOLE_CFILES += $(SUBSYS_CONSOLE_DIR)/ext/console_http.c 
endif
ifeq ($(SUBSYS_WSS_DEMO_ENABLE),y)
SUBSYS_CONSOLE_CFILES += $(SUBSYS_CONSOLE_DIR)/ext/console_websocket.c 
endif
ifeq ($(SUBSYS_AI_ENABLE),y)
SUBSYS_CONSOLE_CFILES += $(SUBSYS_CONSOLE_DIR)/ext/console_ai.c 
endif
ifeq ($(SUBSYS_AUDIO_DEMO_ENABLE),y)
SUBSYS_CONSOLE_CFILES += $(SUBSYS_CONSOLE_DIR)/ext/console_audio.c 
endif

ifeq ($(SUBSYS_GPIO_TEST_ENABLE),y)
CFLAGS += -DFEATURE_SUBSYS_GPIO_TEST_ENABLE
SUBSYS_CONSOLE_CFILES += $(SUBSYS_CONSOLE_DIR)/ext/console_gpio_test.c
endif

ifeq ($(SUBSYS_SYSTIME_TEST_ENABLE),y)
CFLAGS += -DFEATURE_SUBSYS_SYSTIME_TEST_ENABLE
SUBSYS_CONSOLE_CFILES += $(SUBSYS_CONSOLE_DIR)/ext/console_time_test.c
endif

ifeq ($(SUBSYS_SYSLOG_TEST_ENABLE),y)
CFLAGS += -DFEATURE_SUBSYS_SYSLOG_TEST_ENABLE
SUBSYS_CONSOLE_CFILES += $(SUBSYS_CONSOLE_DIR)/ext/console_log.c
endif

ifeq ($(SUBSYS_STORAGE_TEST_ENABLE),y)
CFLAGS += -DFEATURE_SUBSYS_STORAGE_TEST_ENABLE
SUBSYS_CONSOLE_CFILES += $(SUBSYS_CONSOLE_DIR)/ext/console_storage_test.c
ifeq ($(SUBSYS_JSONDB_TEST_ENABLE),y)
CFLAGS += -DFEATURE_SUBSYS_JSONDB_TEST_ENABLE
endif
endif

ifeq ($(SUBSYS_SOCKET_TEST_ENABLE),y)
CFLAGS += -DFEATURE_SUBSYS_SOCKET_TEST_ENABLE
SUBSYS_CONSOLE_CFILES += $(SUBSYS_CONSOLE_DIR)/ext/console_socket_test.c
endif

ifeq ($(SUBSYS_HTTP_TEST_ENABLE),y)
CFLAGS += -DFEATURE_SUBSYS_HTTP_TEST_ENABLE
SUBSYS_CONSOLE_CFILES += $(SUBSYS_CONSOLE_DIR)/ext/console_http_test.c
endif

ifeq ($(SUBSYS_MOBILE_TEST_ENABLE),y)
CFLAGS += -DFEATURE_SUBSYS_MOBILE_TEST_ENABLE
SUBSYS_CONSOLE_CFILES += $(SUBSYS_CONSOLE_DIR)/ext/console_mobile_test.c
endif

ifeq ($(SUBSYS_AUDIO_TEST_ENABLE),y)
CFLAGS += -DFEATURE_SUBSYS_AUDIO_TEST_ENABLE
SUBSYS_CONSOLE_CFILES += $(SUBSYS_CONSOLE_DIR)/ext/console_audio_test.c 
endif

ifeq ($(SUBSYS_GNSS_TEST_ENABLE),y)
CFLAGS += -DFEATURE_SUBSYS_GNSS_TEST_ENABLE
SUBSYS_CONSOLE_CFILES += $(SUBSYS_CONSOLE_DIR)/ext/console_gnss_test.c 
endif

ifeq ($(SUBSYS_TP_TEST_ENABLE),y)
CFLAGS += -DFEATURE_SUBSYS_TP_TEST_ENABLE
SUBSYS_CONSOLE_CFILES += $(SUBSYS_CONSOLE_DIR)/ext/console_tp_test.c 
endif

ifeq ($(SUBSYS_SENSORHUB_TEST_ENABLE),y)
CFLAGS += -DFEATURE_SUBSYS_SENSORHUB_TEST_ENABLE
SUBSYS_CONSOLE_CFILES += $(SUBSYS_CONSOLE_DIR)/ext/console_sensorhub_test.c
endif

ifeq ($(SUBSYS_RIL_TEST_ENABLE),y)
CFLAGS += -DFEATURE_SUBSYS_RIL_TEST_ENABLE
SUBSYS_CONSOLE_CFILES += $(SUBSYS_CONSOLE_DIR)/ext/console_ril_test.c 
endif

ifeq ($(SUBSYS_REG_TEST_ENABLE),y)
CFLAGS += -DFEATURE_SUBSYS_REG_TEST_ENABLE
SUBSYS_CONSOLE_CFILES += $(SUBSYS_CONSOLE_DIR)/ext/console_reg_test.c
endif

ifeq ($(SUBSYS_MINIZ_TEST_ENABLE),y)
CFLAGS += -DFEATURE_SUBSYS_MINIZ_TEST_ENABLE
SUBSYS_CONSOLE_CFILES += $(SUBSYS_CONSOLE_DIR)/ext/console_miniz_test.c 
endif

ifeq ($(SUBSYS_DEVICEMANAGER_TEST_ENABLE),y)
CFLAGS += -DFEATURE_SUBSYS_DEVICEMANAGER_TEST_ENABLE
SUBSYS_CONSOLE_CFILES += $(SUBSYS_CONSOLE_DIR)/ext/console_devicemanager_test.c 
endif

ifeq ($(SUBSYS_SERVICEMANAGER_TEST_ENABLE),y)
CFLAGS += -DFEATURE_SUBSYS_SERVICEMANAGER_TEST_ENABLE
SUBSYS_CONSOLE_CFILES += $(SUBSYS_CONSOLE_DIR)/ext/console_servicemanager_test.c 
endif

ifeq ($(SUBSYS_CAMERA_ENABLE),y)
CFLAGS += -DFEATURE_SUBSYS_CAMERA_ENABLE
SUBSYS_CONSOLE_CFILES += $(SUBSYS_CONSOLE_DIR)/ext/console_camera.c 
endif

ifeq ($(SUBSYS_APP_MANAGER_ENABLE),y)
CFLAGS += -DFEATURE_SUBSYS_APP_MANAGER_ENABLE
SUBSYS_CONSOLE_CFILES += $(SUBSYS_CONSOLE_DIR)/ext/console_apps.c 
endif

ifeq ($(SUBSYS_GRAPHIC_OPENIMAGE_ENABLE),y)
CFLAGS += -DFEATURE_SUBSYS_GRAPHIC_OPENIMAGE_ENABLE
SUBSYS_CONSOLE_CFILES += $(SUBSYS_CONSOLE_DIR)/ext/console_image.c 
endif

ifeq ($(SUBSYS_ZIP_ENABLE),y)
SUBSYS_CONSOLE_CFILES += $(SUBSYS_CONSOLE_DIR)/ext/console_zip.c 
endif

SUBSYS_CONSOLE_COBJSTEMP := $(patsubst %.c, %.o, $(SUBSYS_CONSOLE_CFILES))
SUBSYS_CONSOLE_COBJSTEMP :=$(subst $(SUBSYS_CONSOLE_DIR),PLAT/subsys/apphub/console,$(SUBSYS_CONSOLE_COBJSTEMP))
SUBSYS_CONSOLE_COBJS := $(addprefix $(BUILDDIR)/, $(SUBSYS_CONSOLE_COBJSTEMP))
SUBSYS_CONSOLE_PPFILES := $(patsubst %.o, %.pp, $(SUBSYS_CONSOLE_COBJS))
PPFILES += $(SUBSYS_CONSOLE_PPFILES)

ifeq ($(SUBSYS_FINSH_ENABLE),y)
include $(SUBSYS_CONSOLE_DIR)/finsh/Makefile.inc
endif
ifeq ($(SUBSYS_PYTHON_ENABLE),y)
include $(SUBSYS_CONSOLE_DIR)/pikapython/Makefile.inc
endif
ifeq ($(SUBSYS_UARTSERVICE_ENABLE),y)
include $(SUBSYS_CONSOLE_DIR)/uartservice/Makefile.inc
endif

ifeq ($(SUBSYS_MICROPYTHON_ENABLE),y)
include $(SUBSYS_CONSOLE_DIR)/py/Makefile.inc
endif

ifneq ($(MAKECMDGOALS), build-unilog)
-include $(SUBSYS_CONSOLE_COBJS:.o=.d)
endif
-include $(SUBSYS_CONSOLE_COBJS:.o=.dd)

ifeq ($(TOOLCHAIN),GCC)

CFLAGS_INC += -I $(TOP)/PLAT/os/freertos/portable/gcc

lib-y += libsubsys_console.a

$(BUILDDIR)/lib/libsubsys_console.a: $(SUBSYS_CONSOLE_COBJS)
	@mkdir -p $(dir $@)
	$(ECHO) AR $@
	$(Q)$(AR) -cr $@ $^

endif

ifeq ($(TOOLCHAIN),ARMCC)

CFLAGS_INC += -I $(TOP)/PLAT/os/freertos/portable/keil

lib-y += libsubsys_console.lib

$(BUILDDIR)/lib/libsubsys_console.lib: $(SUBSYS_CONSOLE_COBJS)
	@mkdir -p $(dir $@)
	$(ECHO) AR $@
	$(Q)$(AR) $(ARFLAGS) $@ $^

endif
